## sdkconfig.defaults
```kconfig
CONFIG_BT_ENABLED=y
CONFIG_BT_NIMBLE_ENABLED=y
CONFIG_BT_NIMBLE_ROLE_PERIPHERAL=y
CONFIG_BT_NIMBLE_ROLE_CENTRAL=y
CONFIG_BT_NIMBLE_LOG_LEVEL=1
CONFIG_I2C_ENABLE=y
CONFIG_ADC_ENABLE=y
CONFIG_FREERTOS_CHECK_STACKOVERFLOW_CANARY=1
CONFIG_FREERTOS_CHECK_MUTEX_GIVEN_BY_MULTIPLE_TASKS=1
CONFIG_FREERTOS_DEBUG_OCDAWARE=1
CONFIG_ESP_ERR_TO_NAME_LOOKUP=y
CONFIG_ESP_SYSTEM_PANIC_PRINT_HALT=y
CONFIG_ESP_WIFI_SSID=y
CONFIG_ESP_WIFI_PASSWORD=y
CONFIG_ESP_WIFI_SSID_MAX_LENGTH=32
CONFIG_ESP_WIFI_PASSWORD_MAX_LENGTH=64
```
